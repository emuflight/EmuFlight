#include <stdint.h>
#include "common/maths.h"

#include "ch.h"
#include "osd_utils.h"
#include "arm_math.h"
#include "platform.h"
#include "drivers/light_led.h"

#include "common/maths.h"
#include "common/axis.h"
#include "common/color.h"
#include "common/utils.h"
#include "common/printf.h"
#include "common/typeconversion.h"

#include "drivers/sensor.h"
#include "drivers/system.h"
#include "drivers/serial.h"
#include "drivers/timer.h"
#include "drivers/light_led.h"
#include "drivers/light_ws2811strip.h"
#include "drivers/sound_beeper.h"
#include "pg/vcd.h"
#include "drivers/max7456.h"
#include "drivers/max7456_symbols.h"

#include "sensors/sensors.h"
#include "sensors/boardalignment.h"
#include "sensors/compass.h"
#include "sensors/acceleration.h"
#include "sensors/barometer.h"
#include "sensors/gyro.h"
#include "sensors/battery.h"

#include "io/flashfs.h"
#include "io/gimbal.h"
#include "io/gps.h"
#include "io/ledstrip.h"
#include "io/serial.h"
#include "io/beeper.h"
#include "io/osd.h"

#include "telemetry/telemetry.h"

#include "flight/mixer.h"
#include "flight/failsafe.h"
#include "flight/imu.h"

#include "brainfpv/spectrograph.h"

#if defined(USE_BRAINFPV_SPECTROGRAPH)

#define SAMPLING_FREQ 3200
#define FFT_BIN(freq) ((SPEC_FFT_LENGTH / 2 - 1) * freq) / (SAMPLING_FREQ / 2)

#define SPEC_MAX_FREQ 800
#define SPEC_N_SAMPLES (FFT_BIN(SPEC_MAX_FREQ) + 1)

enum GyroAxis {
    AXIS_ROLL,
    AXIS_PITCH,
    AXIS_YAW,
    AXIS_ALL
};



// Hanning window
const float FFT_WINDOW[SPEC_FFT_LENGTH] = {
#if (SPEC_FFT_LENGTH == 512)
    0.00000, 0.00004, 0.00015, 0.00034, 0.00060, 0.00094, 0.00136, 0.00185, 0.00242, 0.00306, 0.00377, 0.00457, 0.00543, 0.00637, 0.00739, 0.00848,
    0.00964, 0.01088, 0.01220, 0.01358, 0.01504, 0.01658, 0.01818, 0.01986, 0.02161, 0.02344, 0.02533, 0.02730, 0.02934, 0.03145, 0.03363, 0.03589,
    0.03821, 0.04060, 0.04306, 0.04559, 0.04819, 0.05086, 0.05359, 0.05640, 0.05927, 0.06220, 0.06521, 0.06827, 0.07141, 0.07461, 0.07787, 0.08120,
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    0.00848, 0.00739, 0.00637, 0.00543, 0.00457, 0.00377, 0.00306, 0.00242, 0.00185, 0.00136, 0.00094, 0.00060, 0.00034, 0.00015, 0.00004, 0.00000
#elif (SPEC_FFT_LENGTH == 1024)
    0.00000, 0.00001, 0.00004, 0.00008, 0.00015, 0.00024, 0.00034, 0.00046, 0.00060, 0.00076, 0.00094, 0.00114, 0.00136, 0.00159, 0.00185, 0.00212,
    0.00241, 0.00272, 0.00305, 0.00340, 0.00377, 0.00415, 0.00456, 0.00498, 0.00542, 0.00588, 0.00636, 0.00686, 0.00738, 0.00791, 0.00846, 0.00904,
    0.00963, 0.01024, 0.01086, 0.01151, 0.01217, 0.01286, 0.01356, 0.01428, 0.01501, 0.01577, 0.01654, 0.01734, 0.01815, 0.01898, 0.01982, 0.02069,
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    0.00212, 0.00185, 0.00159, 0.00136, 0.00114, 0.00094, 0.00076, 0.00060, 0.00046, 0.00034, 0.00024, 0.00015, 0.00008, 0.00004, 0.00001, 0.00000
#else
#error(No WINDOW for this FFT_LENGTH)
#endif
};

const char * AXIS_NAMES[] = {"ROLL", "PITCH", "YAW"};



float spec_gyro_data_roll[SPEC_FFT_LENGTH];
float spec_gyro_data_pitch[SPEC_FFT_LENGTH];
float spec_gyro_data_yaw[SPEC_FFT_LENGTH];
float fft_out[SPEC_FFT_LENGTH];

float * spec_gyro_data_rpy[3] = {spec_gyro_data_roll, spec_gyro_data_pitch, spec_gyro_data_yaw};

static float max_rpy[3] = {0, 0, 0};
static uint8_t spec_disp_buffer_rpy[3][SPEC_N_SAMPLES];
static uint8_t spec_disp_buffer_max_rpy[3][SPEC_N_SAMPLES];

volatile bool spec_data_processed = false;

static mutex_t fftOutputMtx;
binary_semaphore_t spectrographDataReadySemaphore;

static arm_rfft_fast_instance_f32 fft_inst;

void spectrographInit()
{
    arm_rfft_fast_init_f32(&fft_inst, SPEC_FFT_LENGTH);
    chMtxObjectInit(&fftOutputMtx);

    memset(spec_disp_buffer_max_rpy[0], 0, SPEC_N_SAMPLES);
    memset(spec_disp_buffer_max_rpy[1], 0, SPEC_N_SAMPLES);
    memset(spec_disp_buffer_max_rpy[2], 0, SPEC_N_SAMPLES);
}


void spectrographMain()
{
    float max_val;
    float old_max;
    float this_val;
    uint32_t max_idx;

    chMtxLock(&fftOutputMtx);
    for (int axis = 0; axis < 3; axis ++) {
        for (int i=0; i<SPEC_FFT_LENGTH; i++) {
            spec_gyro_data_rpy[axis][i] *= FFT_WINDOW[i];
        }
        arm_rfft_fast_f32(&fft_inst, spec_gyro_data_rpy[axis], fft_out, 0);
        arm_cmplx_mag_f32(fft_out, fft_out, SPEC_N_SAMPLES);

        #define MAX_START_FREQ 50
        arm_max_f32(&fft_out[FFT_BIN(MAX_START_FREQ)], SPEC_N_SAMPLES - FFT_BIN(MAX_START_FREQ) - 1, &max_val, &max_idx);

        old_max = max_rpy[axis];
        max_rpy[axis] = MAX(max_rpy[axis], max_val);

        for (int i=0; i<SPEC_N_SAMPLES; i++){
            this_val = MIN(fft_out[i + 1], max_rpy[axis]); // clamp values
            spec_disp_buffer_max_rpy[axis][i] = 255 * MAX(this_val, old_max * (float)spec_disp_buffer_max_rpy[axis][i] / 255) / max_rpy[axis];
            spec_disp_buffer_rpy[axis][i] = 255 * (this_val / max_rpy[axis]);
        }
    }
    chMtxUnlock(&fftOutputMtx);

    spec_data_processed = true;
}



void spectrographDraw(uint16_t x0, uint16_t y0, uint16_t width, uint16_t height, enum GyroAxis axis)
{
    char tmp_str[10];
    uint8_t this_height;
    uint16_t freq;

    if (axis == AXIS_ALL){
        return;
    }

    write_hline_lm(x0 ,x0 + width , y0, 1, 1);
    write_hline_lm(x0 ,x0 + width , y0 + 1, 0, 1);
    write_vline_lm(x0, y0, y0 - height + 10, 1, 1);
    write_vline_lm(x0 - 1, y0 + 1, y0 - height + 10, 0, 1);

    write_string(AXIS_NAMES[axis], x0 + width, y0 - height, 0, 0, TEXT_VA_TOP, TEXT_HA_RIGHT, FONT_OUTLINED8X8);

    for (int i=0; i<5; i++) {
        tfp_sprintf(tmp_str, "%d", i * SPEC_MAX_FREQ / 4);
        write_string(tmp_str, x0 + i * width / 4, y0 + 2, 0, 0, TEXT_VA_TOP, TEXT_HA_CENTER, FONT_OUTLINED8X8);
    }

    chMtxLock(&fftOutputMtx);
    for (int i=0; i < width; i++) {
        freq = (i * SPEC_MAX_FREQ) / width;
        this_height = (height * (uint16_t)spec_disp_buffer_rpy[axis][FFT_BIN(freq)]) >> 8;
        write_vline_lm(x0 + i, y0, y0 -this_height , 1, 1);
        write_pixel_lm(x0 + i, y0 -this_height , 1, 0);

        this_height = (height * (uint16_t)spec_disp_buffer_max_rpy[axis][FFT_BIN(freq)]) >> 8;
        write_pixel_lm(x0 + i, y0 -this_height, 1, 0);
        write_pixel_lm(x0 + i, y0 -this_height + 1, 1, 1);
        write_pixel_lm(x0 + i, y0 -this_height - 1, 1, 1);
    }
    tfp_sprintf(tmp_str, "%d", (int)max_rpy[axis] / SPEC_FFT_LENGTH);
    write_string(tmp_str, x0, y0 - height, 0, 0, TEXT_VA_TOP, TEXT_HA_CENTER, FONT_OUTLINED8X8);
    chMtxUnlock(&fftOutputMtx);

    if (gyroConfig()->gyro_soft_notch_hz_1) {
        uint16_t pos = x0 + (gyroConfig()->gyro_soft_notch_hz_1 * width) / SPEC_MAX_FREQ;
        write_vline_lm(pos, y0, y0 - height + 10, 0, 1);
        write_string("N1", pos, y0 - height, 0, 0, TEXT_VA_TOP, TEXT_HA_CENTER, FONT_OUTLINED8X8);
        pos = x0 + (gyroConfig()->gyro_soft_notch_cutoff_1 * width) / SPEC_MAX_FREQ;
        write_vline_lm(pos, y0, y0 - height + 10, 0, 1);
        write_string("N1", pos, y0 - height, 0, 0, TEXT_VA_TOP, TEXT_HA_CENTER, FONT_OUTLINED8X8);
    }

    if (gyroConfig()->gyro_soft_notch_hz_2) {
        uint16_t pos = x0 + (gyroConfig()->gyro_soft_notch_hz_2 * width) / SPEC_MAX_FREQ;
        write_vline_lm(pos, y0, y0 - height + 10, 0, 1);
        write_string("N2", pos, y0 - height, 0, 0, TEXT_VA_TOP, TEXT_HA_CENTER, FONT_OUTLINED8X8);
        pos = x0 + (gyroConfig()->gyro_soft_notch_cutoff_2 * width) / SPEC_MAX_FREQ;
        write_vline_lm(pos, y0, y0 - height + 10, 0, 1);
        write_string("N2", pos, y0 - height, 0, 0, TEXT_VA_TOP, TEXT_HA_CENTER, FONT_OUTLINED8X8);
    }
}

#define GRAPH_LEFT (GRAPHICS_LEFT + 20)
#define GRAPH_BOTTOM (GRAPHICS_BOTTOM - 30)
#define GRAPH_WIDTH (GRAPHICS_RIGHT - GRAPHICS_LEFT - 40)
#define GRAPH_HEIGHT_TOT 200
#define GRAPH_HEIGHT_SPACING 10
#define GRAPH_HEIGHT_SINGLE (GRAPH_HEIGHT_TOT / 3 - GRAPH_HEIGHT_SPACING)


void  spectrographOSD(enum SpecCommand command)
{
    static enum GyroAxis current_axis = AXIS_ALL;

    switch (current_axis) {
        case AXIS_ALL:
            spectrographDraw(GRAPH_LEFT, GRAPH_BOTTOM - 2 * (GRAPH_HEIGHT_SINGLE + GRAPH_HEIGHT_SPACING),
                             GRAPH_WIDTH, GRAPH_HEIGHT_SINGLE, AXIS_ROLL);
            spectrographDraw(GRAPH_LEFT, GRAPH_BOTTOM - (GRAPH_HEIGHT_SINGLE + GRAPH_HEIGHT_SPACING),
                             GRAPH_WIDTH, GRAPH_HEIGHT_SINGLE, AXIS_PITCH);
            spectrographDraw(GRAPH_LEFT, GRAPH_BOTTOM,
                             GRAPH_WIDTH, GRAPH_HEIGHT_SINGLE, AXIS_YAW);
            break;
        case AXIS_ROLL:
        case AXIS_PITCH:
        case AXIS_YAW:
            spectrographDraw(GRAPH_LEFT, GRAPH_BOTTOM,
                             GRAPH_WIDTH, GRAPH_HEIGHT_TOT - 20, current_axis);
            break;
    }

    switch (command) {
        case SPEC_COMMAND_SWAXIS:
            if (current_axis == AXIS_ALL)
                current_axis = AXIS_ROLL;
            else
                current_axis += 1;
            break;
        default:
            break;
    }
    write_string("GYRO SPECTRUM", GRAPHICS_X_MIDDLE, GRAPHICS_BOTTOM - GRAPH_HEIGHT_TOT - 30, 0, 0, TEXT_VA_TOP, TEXT_HA_CENTER, FONT8X10);
    write_string("ROLL RIGHT: SWITCH   ROLL LEFT: EXIT", GRAPHICS_X_MIDDLE, GRAPHICS_BOTTOM - 18, 0, 0, TEXT_VA_TOP, TEXT_HA_CENTER, FONT8X10);
}

#endif /* defined(USE_BRAINFPV_SPECTROGRAPH) */































